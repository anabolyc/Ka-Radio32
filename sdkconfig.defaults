## sdkconfig.defaults
```kconfig
# Override defaults here

#
# Wifi Configuration
#
CONFIG_WIFI_SSID="wifi-12-private"
CONFIG_WIFI_PASSWORD="9263777101"
# end of Wifi Configuration

#
# Audio Output
#
CONFIG_AUDIO_OUTPUT_MODE_I2S=y
# CONFIG_AUDIO_OUTPUT_MODE_I2S_MERUS is not set
# CONFIG_AUDIO_OUTPUT_MODE_DAC_BUILT_IN is not set
# CONFIG_AUDIO_OUTPUT_MODE_PDM is not set
# CONFIG_AUDIO_OUTPUT_MODE_VS1053 is not set
# CONFIG_AUDIO_OUTPUT_MODE_SPDIF is not set
CONFIG_AUDIO_OUTPUT_MODE=0
# end of Audio Output

CONFIG_PARTITION_TABLE_OFFSET=0x9000
CONFIG_ESP32_DEFAULT_CPU_FREQ_240=y
CONFIG_ESP32_DEFAULT_CPU_FREQ_MHZ=240
CONFIG_ESPTOOLPY_FLASHSIZE_16MB=y
CONFIG_ESPTOOLPY_FLASHSIZE="16MB"
CONFIG_COMPILER_OPTIMIZATION_PERF=y
CONFIG_FLASHMODE_QIO=y
CONFIG_ESP32_SPIRAM_SUPPORT=y

#
# SPI RAM config
#
CONFIG_SPIRAM_TYPE_AUTO=y
CONFIG_SPIRAM_SIZE=-1
CONFIG_SPIRAM_SPEED_80M=y
CONFIG_SPIRAM=y
CONFIG_SPIRAM_BOOT_INIT=y
# CONFIG_SPIRAM_IGNORE_NOTFOUND is not set
# CONFIG_SPIRAM_USE_MEMMAP is not set
# CONFIG_SPIRAM_USE_CAPS_ALLOC is not set
CONFIG_SPIRAM_USE_MALLOC=y
CONFIG_SPIRAM_MEMTEST=y
CONFIG_SPIRAM_MALLOC_ALWAYSINTERNAL=16384
# CONFIG_SPIRAM_TRY_ALLOCATE_WIFI_LWIP is not set
CONFIG_SPIRAM_MALLOC_RESERVE_INTERNAL=32768
# CONFIG_SPIRAM_ALLOW_BSS_SEG_EXTERNAL_MEMORY is not set
CONFIG_SPIRAM_CACHE_WORKAROUND=y

#
# SPIRAM cache workaround debugging
#
CONFIG_SPIRAM_CACHE_WORKAROUND_STRATEGY_MEMW=y
# CONFIG_SPIRAM_CACHE_WORKAROUND_STRATEGY_DUPLDST is not set
# CONFIG_SPIRAM_CACHE_WORKAROUND_STRATEGY_NOPS is not set
# end of SPIRAM cache workaround debugging

CONFIG_SPIRAM_BANKSWITCH_ENABLE=y
CONFIG_SPIRAM_BANKSWITCH_RESERVE=8
# CONFIG_SPIRAM_ALLOW_STACK_EXTERNAL_MEMORY is not set
# CONFIG_SPIRAM_OCCUPY_HSPI_HOST is not set
CONFIG_SPIRAM_OCCUPY_VSPI_HOST=y
# CONFIG_SPIRAM_OCCUPY_NO_HOST is not set

#
# PSRAM clock and cs IO for ESP32-DOWD
#
CONFIG_D0WD_PSRAM_CLK_IO=17
CONFIG_D0WD_PSRAM_CS_IO=16
# end of PSRAM clock and cs IO for ESP32-DOWD

#
# PSRAM clock and cs IO for ESP32-D2WD
#
CONFIG_D2WD_PSRAM_CLK_IO=9
CONFIG_D2WD_PSRAM_CS_IO=10
# end of PSRAM clock and cs IO for ESP32-D2WD

#
# PSRAM clock and cs IO for ESP32-PICO
#
CONFIG_PICO_PSRAM_CS_IO=10
# end of PSRAM clock and cs IO for ESP32-PICO
```

## sdkconfig.defaults.nospiram
```kconfig
# Override defaults here

#
# ESP32-specific config
#
CONFIG_ESP32_DEFAULT_CPU_FREQ_240=y
CONFIG_ESP32_DEFAULT_CPU_FREQ_MHZ=240
CONFIG_ESPTOOLPY_FLASHSIZE_4MB=y
CONFIG_ESPTOOLPY_FLASHSIZE="4MB"
CONFIG_COMPILER_OPTIMIZATION_PERF=y
CONFIG_FLASHMODE_QIO=y

#
# Web Radio / Bluetooth Speaker
#

#
# Wifi Configuration
#
CONFIG_WIFI_SSID="wifi-12-private"
CONFIG_WIFI_PASSWORD="9263777101"
# end of Wifi Configuration

#
# Audio Output
#
CONFIG_AUDIO_OUTPUT_MODE_I2S=y
# CONFIG_AUDIO_OUTPUT_MODE_I2S_MERUS is not set
# CONFIG_AUDIO_OUTPUT_MODE_DAC_BUILT_IN is not set
# CONFIG_AUDIO_OUTPUT_MODE_PDM is not set
# CONFIG_AUDIO_OUTPUT_MODE_VS1053 is not set
# CONFIG_AUDIO_OUTPUT_MODE_SPDIF is not set
CONFIG_AUDIO_OUTPUT_MODE=0
# end of Audio Output
# end of Web Radio / Bluetooth Speaker
```
